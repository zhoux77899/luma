#pragma once

#include "luma/core/display.h"
#include "luma/ui/font-cjk.h"

#include <cstdint>

// Luma UI bitmap font: ASCII 0x20-0x7F from Fusion Pixel 10px monospaced latin
// (regular) and Fusion Bold Pixel 10px monospaced latin (bold), plus the
// Fusion Pixel 10px monospaced zh_hans common set. OFL-1.1.
// Regenerated by tools/gen-ui-font.py. The firmware build does not run that script.
namespace luma {
namespace font {

constexpr int kGlyphWidth = 5;
constexpr int kBoldGlyphWidth = 6;
constexpr int kGlyphHeight = 10;
constexpr int kFirstCode = 32;
constexpr int kGlyphCount = 96;

struct Glyph {
    const uint16_t* rows;
    int width;
};

static const uint16_t kRegular[96][kGlyphHeight] = {
    {0x0000, 0x0000, 0x0000, 0x0000, 0x0000, 0x0000, 0x0000, 0x0000, 0x0000, 0x0000},  // space
    {0x0000, 0x0000, 0x2000, 0x2000, 0x2000, 0x2000, 0x2000, 0x0000, 0x2000, 0x0000},  // !
    {0x0000, 0x0000, 0x5000, 0x5000, 0x0000, 0x0000, 0x0000, 0x0000, 0x0000, 0x0000},  // "
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    {0x0000, 0x0000, 0x0000, 0x0000, 0x0000, 0x0000, 0x0000, 0x0000, 0x0000, 0x0000},  // DEL
};

static const uint16_t kBold[96][kGlyphHeight] = {
    {0x0000, 0x0000, 0x0000, 0x0000, 0x0000, 0x0000, 0x0000, 0x0000, 0x0000, 0x0000},  // space
    {0x0000, 0x0000, 0x3000, 0x3000, 0x3000, 0x3000, 0x3000, 0x0000, 0x3000, 0x0000},  // !
    {0x0000, 0x0000, 0x6800, 0x6800, 0x0000, 0x0000, 0x0000, 0x0000, 0x0000, 0x0000},  // "
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    {0x0000, 0x0000, 0x0000, 0x0000, 0x0000, 0x0000, 0x0000, 0x0000, 0x0000, 0x0000},  // DEL
};

inline const uint16_t* glyphRows(char character, bool bold) {
    unsigned char code = static_cast<unsigned char>(character);
    if (code < kFirstCode || code > 127) {
        code = static_cast<unsigned char>('?');
    }
    return (bold ? kBold : kRegular)[code - kFirstCode];
}

inline int glyphWidth(bool bold) {
    return bold ? kBoldGlyphWidth : kGlyphWidth;
}

inline bool nextCodepoint(const char*& cursor, uint32_t& code) {
    if (cursor == nullptr || *cursor == '\0') {
        return false;
    }
    const unsigned char lead = static_cast<unsigned char>(*cursor);
    auto trail = [](unsigned char byte) { return (byte & 0xC0u) == 0x80u; };
    if (lead < 0x80u) {
        code = lead;
        ++cursor;
        return true;
    }
    if ((lead & 0xE0u) == 0xC0u) {
        const unsigned char b1 = static_cast<unsigned char>(cursor[1]);
        if (b1 == 0 || !trail(b1)) {
            code = 0xFFFDu;
            ++cursor;
            return true;
        }
        code = (static_cast<uint32_t>(lead & 0x1Fu) << 6) | (b1 & 0x3Fu);
        cursor += 2;
        return true;
    }
    if ((lead & 0xF0u) == 0xE0u) {
        const unsigned char b1 = static_cast<unsigned char>(cursor[1]);
        const unsigned char b2 = b1 == 0 ? 0 : static_cast<unsigned char>(cursor[2]);
        if (b1 == 0 || b2 == 0 || !trail(b1) || !trail(b2)) {
            code = 0xFFFDu;
            ++cursor;
            return true;
        }
        code = (static_cast<uint32_t>(lead & 0x0Fu) << 12) |
               (static_cast<uint32_t>(b1 & 0x3Fu) << 6) | (b2 & 0x3Fu);
        cursor += 3;
        return true;
    }
    if ((lead & 0xF8u) == 0xF0u) {
        const unsigned char b1 = static_cast<unsigned char>(cursor[1]);
        const unsigned char b2 = b1 == 0 ? 0 : static_cast<unsigned char>(cursor[2]);
        const unsigned char b3 = b2 == 0 ? 0 : static_cast<unsigned char>(cursor[3]);
        if (b1 == 0 || b2 == 0 || b3 == 0 || !trail(b1) || !trail(b2) || !trail(b3)) {
            code = 0xFFFDu;
            ++cursor;
            return true;
        }
        code = (static_cast<uint32_t>(lead & 0x07u) << 18) |
               (static_cast<uint32_t>(b1 & 0x3Fu) << 12) |
               (static_cast<uint32_t>(b2 & 0x3Fu) << 6) | (b3 & 0x3Fu);
        cursor += 4;
        return true;
    }
    code = 0xFFFDu;
    ++cursor;
    return true;
}

inline Glyph glyphFor(uint32_t code, bool bold) {
    if (code >= static_cast<uint32_t>(kFirstCode) && code <= 127u) {
        const unsigned char ascii = static_cast<unsigned char>(code);
        return {(bold ? kBold : kRegular)[ascii - kFirstCode], glyphWidth(bold)};
    }
    const uint16_t* rows = cjkGlyphRows(code);
    if (rows != nullptr) {
        return {rows, kCjkGlyphWidth};
    }
    return {glyphRows('?', bold), glyphWidth(bold)};
}

inline int textWidth(const char* text, int size, bool bold = false) {
    if (text == nullptr) {
        return 0;
    }
    const int scale = size < 1 ? 1 : size;
    int width = 0;
    const char* cursor = text;
    uint32_t code = 0;
    while (nextCodepoint(cursor, code)) {
        width += glyphFor(code, bold).width;
    }
    return width * scale;
}

template <typename SetPixel>
void drawText(Point origin, TextStyle style, const char* text, SetPixel set_pixel) {
    if (text == nullptr) {
        return;
    }
    const int scale = style.size < 1 ? 1 : style.size;
    int x = origin.x;
    const char* cursor = text;
    uint32_t code = 0;
    while (nextCodepoint(cursor, code)) {
        const Glyph glyph = glyphFor(code, style.bold);
        for (int row = 0; row < kGlyphHeight; ++row) {
            for (int column = 0; column < glyph.width; ++column) {
                if ((glyph.rows[row] & static_cast<uint16_t>(0x8000u >> column)) == 0) {
                    continue;
                }
                for (int dy = 0; dy < scale; ++dy) {
                    for (int dx = 0; dx < scale; ++dx) {
                        set_pixel(x + column * scale + dx, origin.y + row * scale + dy,
                                  style.color);
                    }
                }
            }
        }
        x += glyph.width * scale;
    }
}

}  // namespace font
}  // namespace luma
